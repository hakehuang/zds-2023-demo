## CMakeLists.txt
```
# Copyright 2022, NXP
#
# SPDX-License-Identifier: Apache-2.0

cmake_minimum_required(VERSION 3.20.0)
find_package(Zephyr REQUIRED HINTS $ENV{ZEPHYR_BASE})
project(mimxrt595_evk_imp)

target_sources(app PRIVATE src/main.c)
```

## Kconfig
```
# Copyright 2022, NXP
#
# SPDX-License-Identifier: Apache-2.0

mainmenu "MIMXRT595_EVK_DSP IMP demo"

source "Kconfig.zephyr"
```

## sample.yaml
```
#
# Copyright 2022, NXP
#
# SPDX-License-Identifier: Apache-2.0
#
sample:
  name: IMP for mimxrt595_evk
common:
  tags: imp
tests:
  sample.boards.mimxrt595_evk_dsp.imp:
    platform_allow: mimxrt595_evk_dsp
```

## prj.conf
```kconfig
#
# Copyright 2022, NXP
#
# SPDX-License-Identifier: Apache-2.0
#
CONFIG_MP_MAX_NUM_CPUS=1
CONFIG_IPM=y
```

## app.overlay
```dts
/*
 * Copyright 2022, NXP
 *
 * SPDX-License-Identifier: Apache-2.0
 */

&mailbox_b {
        label = "mail_box";
	status = "okay";
};
```

## src/main.c
```c
/*
 * Copyright 2022, NXP
 *
 * SPDX-License-Identifier: Apache-2.0
 */

#include <stdio.h>
#include <zephyr/kernel.h>
#include <zephyr/drivers/ipm.h>
#include <zephyr/device.h>
#include <zephyr/init.h>


static const char pong_data[16] = "pong";

//volatile int called = 0;

//static void ipm_receive_callback(const struct device *ipmdev, void *user_data,
//			       uint32_t id, volatile void *data)
//{
//	called = 1;
//}

int main(void)
{
	const struct device *ipm_dev;

	ipm_dev = device_get_binding("mail_box");
	if (!ipm_dev) {
		return -1;
	}

	//ipm_register_callback(ipm_dev, ipm_receive_callback, NULL);
	//ipm_set_enabled(ipm_dev, 1);

	ipm_send(ipm_dev, 1, 0, &pong_data, sizeof(pong_data));
	while (1) {
		k_sleep(K_MSEC(50));
//		ipm_send(ipm_dev, 1, 0, &pong_data, sizeof(pong_data));
	}
	return 0;
}
```

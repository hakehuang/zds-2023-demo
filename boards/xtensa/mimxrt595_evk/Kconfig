## boards/xtensa/mimxrt595_evk/Kconfig.board
```kconfig
# XTENSA board configuration

# Copyright (c) 2022 NXP Semiconductor
# SPDX-License-Identifier: Apache-2.0

config BOARD_RT595_XTENSA
	bool "Xtensa emulation using QEMU"
	select QEMU_TARGET
```

## boards/xtensa/mimxrt595_evk/Kconfig.defconfig
```kconfig
# MIMXRT685-EVK board

# Copyright (c) 2023, NXP
# SPDX-License-Identifier: Apache-2.0

if BOARD_RT595_XTENSA

config BUILD_OUTPUT_BIN
	default n

config BOARD
	default "mimxrt595_evk_xtensa"

config IPM_CONSOLE_STACK_SIZE
	default 2048 if IPM_CONSOLE_RECEIVER

endif # BOARD_RT595_XTENSA
```

## samples/boards/mimxrt595_evk_cm33/ipm/Kconfig
```kconfig
# Copyright 2022, NXP
#
# SPDX-License-Identifier: Apache-2.0

mainmenu "MIMXRT595_EVK_CM33 IMP demo"

source "Kconfig.zephyr"
```

## soc/xtensa/nxp_fusion_dsp/Kconfig
```kconfig
# NXP i.MX8 SoC family configuration options
#
# Copyright (c) 2023 NXP
# SPDX-License-Identifier: Apache-2.0

config SOC_FAMILY_NXP_FUSION_DSP
	bool
	select ARCH_HAS_COHERENCE

if SOC_FAMILY_NXP_FUSION_DSP

config SOC_FAMILY
	string
	default "nxp_fusion_dsp"

# Select SoC Part No. and configuration options
source "soc/xtensa/nxp_fusion_dsp/*/Kconfig.soc"

endif # SOC_FAMILY_NXP_ADSP
```

## soc/xtensa/nxp_fusion_dsp/Kconfig.defconfig
```kconfig
# NXP i.MX8 SoC family default configuration options
#
# Copyright (c) 2023 NXP
# SPDX-License-Identifier: Apache-2.0

source "soc/xtensa/nxp_fusion_dsp/*/Kconfig.defconfig.series"
```

## soc/xtensa/nxp_fusion_dsp/Kconfig.soc
```kconfig
# NXP i.MX8 SoC series selection
#
# Copyright (c) 2023 NXP
# SPDX-License-Identifier: Apache-2.0

source "soc/xtensa/nxp_fusion_dsp/*/Kconfig.series"
```

## soc/xtensa/nxp_fusion_dsp/rt5xx/Kconfig.defconfig.series
```kconfig
# Copyright (c) 2023 NXP
# SPDX-License-Identifier: Apache-2.0

if SOC_SERIES_NXP_RT5XX_FUSION_DSP

config SOC_SERIES
	string
	default "rt5xx"

config SOC_TOOLCHAIN_NAME
	string
	default "sample_controller"

config SOC
	string
	default "sample_controller"

endif # SOC_SERIES_NXP_RT5XX_FUSION_DSP
```

## soc/xtensa/nxp_fusion_dsp/rt5xx/Kconfig.series
```kconfig
# Copyright (c) 2021 NXP
# SPDX-License-Identifier: Apache-2.0

config SOC_SERIES_NXP_RT5XX_FUSION_DSP
	bool "NXP i.MRT5XX FUSION DSP"
	select SOC_FAMILY_NXP_FUSION_DSP
	select XTENSA
	select XTENSA_HAL
	select ARCH_SUPPORTS_COREDUMP
	help
	  NXP i.MXRT5XX FUSION DSP
```

## soc/xtensa/nxp_fusion_dsp/rt5xx/Kconfig.soc
```kconfig
# Copyright (c) 2021 NXP
# SPDX-License-Identifier: Apache-2.0

choice
	prompt "NXP i.MX SoC Selection"

	config SOC_NXP_RT5XX_FUSION_DSP
		bool "RT5xx Fusion DSP"
		depends on SOC_SERIES_NXP_RT5XX_FUSION_DSP

endchoice
```

## west.yml
```yaml
# Copyright (c) 2021 Nordic Semiconductor ASA
# SPDX-License-Identifier: Apache-2.0

manifest:
  self:
    west-commands: scripts/west-commands.yml

  remotes:
    - name: zephyrproject-rtos
      url-base: https://github.com/nxp-zephyr/

  projects:
    - name: zephyr
      remote: zephyrproject-rtos
      revision: zds2023_qemu_cosim
      import:
        # By using name-allowlist we can clone only the modules that are
        # strictly needed by the application.
        name-allowlist:
          - cmsis      # required by the ARM port
          - hal_nxp
```
